## firmware/sdkconfig.defaults
```kconfig
# --- PSRAM ---
CONFIG_SPIRAM=y
CONFIG_SPIRAM_MODE_OCT=y
CONFIG_SPIRAM_SPEED_80M=y
CONFIG_SPIRAM_BOOT_INIT=y
CONFIG_SPIRAM_USE_MALLOC=y

# --- SPI ---
CONFIG_SPI_MASTER_IN_IRAM=y

# --- I2C ---
# Default I2C config is fine; driver configured in code

# --- Stack sizes ---
CONFIG_ESP_MAIN_TASK_STACK_SIZE=32768
CONFIG_PTHREAD_TASK_STACK_SIZE_DEFAULT=8192

# --- Partition table ---
# Custom layout: 4MB app + 12MB SPIFFS data (for avatar, profile, config)
# partitions.csv is copied to the esp-idf-sys build dir via ESP_IDF_GLOB in .cargo/config.toml
CONFIG_PARTITION_TABLE_CUSTOM=y
CONFIG_PARTITION_TABLE_CUSTOM_FILENAME="partitions.csv"

# --- WiFi ---
CONFIG_ESP_WIFI_STATIC_RX_BUFFER_NUM=10
CONFIG_ESP_WIFI_DYNAMIC_RX_BUFFER_NUM=32
CONFIG_ESP_WIFI_DYNAMIC_TX_BUFFER_NUM=32

# --- HTTP Server ---
CONFIG_HTTPD_MAX_REQ_HDR_LEN=1024
CONFIG_HTTPD_URI_MATCH_WILDCARD=y

# --- Flash ---
CONFIG_ESPTOOLPY_FLASHSIZE_16MB=y

# --- Watchdog ---
CONFIG_ESP_TASK_WDT_TIMEOUT_S=30

# --- Logging ---
CONFIG_LOG_DEFAULT_LEVEL_INFO=y
```
